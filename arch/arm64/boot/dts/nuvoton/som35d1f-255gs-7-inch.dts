// SPDX-License-Identifier: GPL-2.0-or-later
/*
 * som-35d1f-255gs-7-inch.dtsi - Device Tree for the som35D1F with a 255GS Carrier and a 7 inch panel.
 *
 * Copyright (C) 2023 EMAC Inc.
 *
 */

/dts-v1/;
#include "ma35d1.dtsi"
#include "som35d1f.dtsi"
#include "som35d1f-255gs.dtsi"

/*
 remove the panel that they have upstream its driver is setup for compatible = "avic,tm070ddh03", "panel-dpi";
 so we delete and create the fema_panel below
 https://github.com/OpenNuvoton/MA35D1_linux-6.6.y/blob/master/arch/arm64/boot/dts/nuvoton/ma35d1.dtsi#L1733
*/

/ {
	model = "EMAC SOM-35D1F with 255gs carrier and 7 inch panel";
	compatible = "emac,som35d1f-255gs-7-inch", "emac,som35d1f-255gs", "emac,som35d1f", "nuvoton,ma35d1";
};

&pwm_backlight {
	status = "okay";
}

&lvds_bridge: {
	status = "okay";
}

&lvds_3v3_reg {
	status = "okay";
};

&fema_panel {
	status = "okay";
};

&gc520l {
	status = "okay";
};

// This driver needs to be installed correctly atm it is not...
&vc8k {
	fb_width = <800>;
	fb_height = <480>;
	status = "okay";
};

&display {
	status = "okay";
};

/*
 * 7-inch touch connector CN4 is intentionally cross-mapped.
 *
 * Panel touch unit:
 *   pin 1 XR / Right  -> TOUCH_Y+ -> TSC2004 Y+
 *   pin 2 YU / Top    -> TOUCH_X- -> TSC2004 X-
 *   pin 3 XL / Left   -> TOUCH_Y- -> TSC2004 Y-
 *   pin 4 YD / Bottom -> TOUCH_X+ -> TSC2004 X+
 *
 * This means panel X/Y are swapped relative to TSC2004 X/Y, AND axis has inversion
 */
&tsc2004 {
	touchscreen-size-x = <800>;
	touchscreen-size-y = <480>;
	touchscreen-x-mm = <152>;
	touchscreen-y-mm = <91>;
	touchscreen-swapped-x-y;
	status = "okay";
};
