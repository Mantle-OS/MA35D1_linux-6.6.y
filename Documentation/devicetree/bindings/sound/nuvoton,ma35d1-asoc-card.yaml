## Documentation/devicetree/bindings/sound/nuvoton,ma35d1-asoc-card.yaml
```yaml
# SPDX-License-Identifier: (GPL-2.0-only OR BSD-2-Clause)
%YAML 1.2
---
$id: http://devicetree.org/schemas/sound/nuvoton,ma35d1-asoc-card.yaml#
$schema: http://devicetree.org/meta-schemas/core.yaml#

title: Nuvoton MA35D1 Graph-Backed ASoC Sound Card

maintainers:
  - Joseph Mills <josephjamesmills@gmail.com>

description:
  Common binding for Nuvoton MA35D1 ASoC sound cards using graph-style
  audio topology.

  The MA35D1 card binding describes the board-level sound card and points
  to one or more CPU DAI graph ports using the dais property. Link-specific
  properties such as dai-format, bitclock-master, frame-master, mclk-fs,
  clock inversion, and TDM slot settings are described on graph endpoints.

  Codec-specific MA35D1 card bindings should reference this schema and
  provide their own compatible string, examples, and any profile-specific
  restrictions.

properties:
  compatible:
    description:
      Codec/profile-specific MA35D1 sound card compatible.
    enum:
      - nuvoton,ma35d1-audio-sgtl5000
      - nuvoton,ma35d1-audio-nau8822

  label:
    $ref: /schemas/types.yaml#/definitions/string
    description:
      User-visible sound card name.

  dais:
    $ref: /schemas/types.yaml#/definitions/phandle-array
    minItems: 1
    description:
      List of CPU DAI graph ports that belong to this sound card. Each
      phandle should point to a port node under an audio DAI controller.
      The port contains endpoint nodes connected to remote codec endpoints.

  widgets:
    $ref: /schemas/types.yaml#/definitions/non-unique-string-array
    description:
      A list of DAPM widgets. Each entry is a pair of strings, the first
      being the widget type and the second being the widget name.

  routing:
    $ref: /schemas/types.yaml#/definitions/non-unique-string-array
    description:
      A list of audio routing connections. Each entry is a pair of strings,
      the first being the sink and the second being the source.

  hp-det-gpios:
    maxItems: 1
    description:
      Optional GPIO for headphone insertion detection.

  mic-det-gpios:
    maxItems: 1
    description:
      Optional GPIO for microphone insertion detection.

  aux-devs:
    $ref: /schemas/types.yaml#/definitions/phandle-array
    description:
      Auxiliary devices such as external amplifiers that should be added
      to the sound card.

required:
  - compatible
  - label
  - dais

additionalProperties: false

examples:
  - |
    sound {
        compatible = "nuvoton,ma35d1-audio-sgtl5000";
        label = "MA35D1-SGTL5000";

        dais = <&i2s0_port>;

        widgets =
            "Headphone", "Headphone Jack",
            "Microphone", "Mic Jack";

        routing =
            "Headphone Jack", "HP_OUT",
            "MIC_IN", "Mic Jack";
    };
...
```

## Documentation/devicetree/bindings/sound/nuvoton,ma35d1-i2s.yaml
```yaml
# SPDX-License-Identifier: (GPL-2.0-only OR BSD-2-Clause)
%YAML 1.2
---
$id: http://devicetree.org/schemas/sound/nuvoton,ma35d1-i2s.yaml#
$schema: http://devicetree.org/meta-schemas/core.yaml#

title: Nuvoton MA35D1 I2S Controller

maintainers:
  - Joseph Mills <josephjamesmills@gmail.com>

description:
  The Nuvoton MA35D1 I2S controller provides a CPU DAI for external
  audio codecs. It supports playback and capture through DMA and may
  be connected to codecs using audio graph endpoints.

allOf:
  - $ref: dai-common.yaml#

properties:
  compatible:
    enum:
      - nuvoton,ma35d1-i2s

  reg:
    maxItems: 1

  interrupts:
    maxItems: 1
    description:
      I2S controller interrupt. This is optional because DMA-only
      operation may not require the interrupt line.

  clocks:
    minItems: 1
    maxItems: 2
    description:
      Clocks used by the I2S controller. The i2s clock is the controller
      functional clock. The optional mclk clock may be used as the parent
      or source for the externally driven master clock when the SoC clock
      tree exposes it separately.

  clock-names:
    minItems: 1
    maxItems: 2
    items:
      enum:
        - i2s
        - mclk

  resets:
    maxItems: 1

  dmas:
    minItems: 1
    maxItems: 2
    description:
      DMA channels used by the I2S controller. A full-duplex controller
      normally provides one TX DMA channel and one RX DMA channel.

  dma-names:
    oneOf:
      - items:
          - const: tx
          - const: rx
      - items:
          - const: tx
      - items:
          - const: rx

  '#sound-dai-cells':
    const: 0

  port:
    $ref: audio-graph-port.yaml#/definitions/port-base
    description:
      Audio graph port containing endpoint nodes that connect this I2S
      controller to external codec endpoints.

required:
  - compatible
  - reg
  - clocks
  - clock-names
  - dmas
  - dma-names
  - '#sound-dai-cells'

additionalProperties: false

examples:
  - |
    #include <dt-bindings/clock/ma35d1-clk.h>
    #include <dt-bindings/dma/ma35d1-dma.h>
    #include <dt-bindings/interrupt-controller/arm-gic.h>

    i2s0: i2s@40480000 {
        compatible = "nuvoton,ma35d1-i2s";
        reg = <0x40480000 0x1000>;

        interrupts = <GIC_SPI 60 IRQ_TYPE_LEVEL_HIGH>;

        clocks = <&clk MA35D1_CLK_I2S0>;
        clock-names = "i2s";

        dmas = <&pdma0 MA35D1_PDMA_I2S0_TX>,
               <&pdma0 MA35D1_PDMA_I2S0_RX>;
        dma-names = "tx", "rx";

        #sound-dai-cells = <0>;

        port {
            i2s0_ep: endpoint {
                remote-endpoint = <&codec_ep>;
                dai-format = "i2s";
                bitclock-master;
                frame-master;
                mclk-fs = <256>;
            };
        };
    };
...
```

## sound/soc/ma35d1/Kconfig
```kconfig
# SPDX-License-Identifier: GPL-2.0-only

config SND_SOC_MA35D1_I2S
	tristate "Nuvoton MA35D1 I2S controller"
	depends on ARCH_MA35D1 || COMPILE_TEST
	depends on COMMON_CLK
	select SND_SOC_GENERIC_DMAENGINE_PCM
	help
	  Say Y or M if you want support for the I2S controller found
	  on Nuvoton MA35D1 SoCs.

	  This driver provides the MA35D1 CPU DAI and registers the
	  DMAengine PCM support used by ASoC sound cards.

config SND_SOC_MA35D1_AUDIO_CARD
	tristate "Nuvoton MA35D1 graph-backed ASoC sound card"
	depends on SND_SOC_MA35D1_I2S
	help
	  Say Y or M if you want support for MA35D1 board-level ASoC
	  sound cards using graph-style device tree endpoints.

	  This driver parses the MA35D1 sound card node and connects
	  MA35D1 I2S CPU DAIs to external codecs using graph endpoints.
	  Codec-specific setup is handled by MA35D1 card profile files.

config SND_SOC_MA35D1_AUDIO_SGTL5000
	bool "MA35D1 SGTL5000 sound card profile"
	depends on SND_SOC_MA35D1_AUDIO_CARD
	select SND_SOC_SGTL5000
	help
	  Enable the MA35D1 sound card profile for boards using an
	  SGTL5000 audio codec.

config SND_SOC_MA35D1_AUDIO_NAU8822
	bool "MA35D1 NAU8822 sound card profile"
	depends on SND_SOC_MA35D1_AUDIO_CARD
	select SND_SOC_NAU8822
	help
	  Enable the MA35D1 sound card profile for boards using a
	  NAU8822 audio codec, such as the Nuvoton MA35D1 evaluation
	  board design.
```
